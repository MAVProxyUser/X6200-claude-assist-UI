## buildroot/br2_external/package/libbladerf/Config.in
```kconfig
config BR2_PACKAGE_LIBBLADERF
	bool "libbladerf"
	depends on BR2_TOOLCHAIN_HAS_THREADS
	select BR2_PACKAGE_LIBUSB
	help
	  libbladeRF alone, from Nuand's bladeRF (none of its tools),
	  for x6x00-rtlspec: the Sentry's VHF/UHF screens through a
	  bladeRF (2.0 micro, x40/x115), opened by it at run time. No
	  FPGA image: Nuand's, put by hand in /mnt/bladerf or in the
	  board's own flash (docs/MANUAL.md).

	  https://github.com/Nuand/bladeRF
```

## buildroot/br2_external/package/libhackrf/Config.in
```kconfig
config BR2_PACKAGE_LIBHACKRF
	bool "libhackrf"
	depends on BR2_TOOLCHAIN_HAS_THREADS
	depends on !BR2_PACKAGE_HACKRF # the same library, with its tools
	select BR2_PACKAGE_LIBUSB
	help
	  libhackrf alone, from Great Scott Gadgets' hackrf (none of
	  its tools: hackrf_transfer transmits), for x6x00-rtlspec:
	  the Sentry's VHF/UHF screens through a HackRF One, and its
	  walkie's transmitter. The tag of the HackRF firmware it is
	  used with (2024.02.1).

	  https://github.com/greatscottgadgets/hackrf
```

## buildroot/br2_external/package/x6x00-dsd-fme/Config.in
```kconfig
config BR2_PACKAGE_X6X00_DSD_FME
	bool "x6x00-dsd-fme"
	depends on BR2_INSTALL_LIBSTDCPP
	depends on BR2_TOOLCHAIN_HAS_THREADS
	select BR2_PACKAGE_LIBSNDFILE
	select BR2_PACKAGE_NCURSES
	select BR2_PACKAGE_PULSEAUDIO
	help
	  dsd-fme (lwvmobile) for the OpenX6X00 SDR daemon: P25,
	  D-STAR, YSF and X2-TDMA found and decoded in the narrow FM
	  channel the Sentry's B listens to. Its voice through a DVSI
	  USB-3000 only (libmbe-dvsi, this repository's
	  tools/dsdfme/mbe_dvsi): never a software vocoder.
	  Installed as /usr/bin/dsd-fme.
```

## buildroot/br2_external/package/x6x00-modem/Config.in
```kconfig
config BR2_PACKAGE_X6X00_MODEM
	bool "x6x00-modem"
	help
	  One end of a modem link between two radios: BinModem's fax
	  modems ported to C (V.21, V.27 ter, V.29) and T.30's
	  procedure, over the radio's own TCI server. Driven from a
	  computer (tools/bench/bench.py radios-modem); it transmits
	  only while that computer says the other radio is off the
	  air. Installed as /usr/bin/x6x00-modem; its source is this
	  repository's tools/modem (GPL-3.0-or-later, as BinModem).
```

## buildroot/br2_external/package/x6x00-rtlspec/Config.in
```kconfig
config BR2_PACKAGE_X6X00_RTLSPEC
	bool "x6x00-rtlspec"
	depends on BR2_TOOLCHAIN_HAS_THREADS
	depends on !BR2_PACKAGE_HACKRF # libhackrf's own package instead
	select BR2_PACKAGE_LIBUSB
	select BR2_PACKAGE_RTLSDR_BLOG
	select BR2_PACKAGE_LIBHACKRF
	select BR2_PACKAGE_LIBBLADERF
	select BR2_PACKAGE_ZLIB # the Meteor pictures' PNGs
	help
	  The daemon that owns the SDR on the HOST port for the
	  OpenX6X00 GUI's Sentry (src/rtl_spectrum.c): an RTL-SDR
	  stick, a HackRF or a bladeRF (libbladeRF opened at run
	  time). Spectrum rows, a channel's audio, SAME, RDS,
	  AIRSPACE's dump1090 samples; FM through a HackRF or bladeRF
	  for the walkie, only in the amateur bands.
	  Installed as /usr/bin/x6x00-rtlspec; its source is this
	  repository's tools/rtlspec.
```
