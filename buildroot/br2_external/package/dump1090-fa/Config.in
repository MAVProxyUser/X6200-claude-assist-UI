## buildroot/br2_external/package/dump1090-fa/Config.in
```kconfig
config BR2_PACKAGE_DUMP1090_FA
	bool "dump1090-fa"
	depends on BR2_TOOLCHAIN_HAS_THREADS
	depends on BR2_USE_MMU # fork()
	select BR2_PACKAGE_NCURSES
	select BR2_PACKAGE_RTLSDR_BLOG
	help
	  FlightAware's Mode S / ADS-B decoder for RTL-SDR sticks, installed
	  as /usr/bin/dump1090-fa. The AIRSPACE screen (src/adsb_rx.c)
	  starts it headless on a stick it finds and reads its raw output
	  on 127.0.0.1:30002. Built for the ARMv7 NEON DSP flavours of the
	  radios' Cortex-A7.

	  https://github.com/flightaware/dump1090

comment "dump1090-fa needs a toolchain w/ threads"
	depends on !BR2_TOOLCHAIN_HAS_THREADS
```

## buildroot/br2_external/package/rtlsdr-blog/Config.in
```kconfig
config BR2_PACKAGE_RTLSDR_BLOG
	bool "rtlsdr-blog"
	depends on BR2_TOOLCHAIN_HAS_THREADS
	select BR2_PACKAGE_LIBUSB
	help
	  librtlsdr and its tools (rtl_test, rtl_sdr, rtl_fm, ...) from the
	  RTL-SDR Blog's fork, which knows the Blog V4's R828D tuner as well
	  as the R820T sticks. The AIRSPACE screen's RTL-SDR support uses it
	  through dump1090-fa. Built with kernel driver detaching, so a DVB-T
	  driver holding the stick lets it go.

	  https://github.com/rtlsdrblog/rtl-sdr-blog

comment "rtlsdr-blog needs a toolchain w/ threads"
	depends on !BR2_TOOLCHAIN_HAS_THREADS
```

## buildroot/br2_external/package/x6x00-rtlspec/Config.in
```kconfig
config BR2_PACKAGE_X6X00_RTLSPEC
	bool "x6x00-rtlspec"
	depends on BR2_TOOLCHAIN_HAS_THREADS
	select BR2_PACKAGE_RTLSDR_BLOG
	help
	  An RTL-SDR stick's spectrum for the OpenX6X00 GUI's Sentry
	  (the F VHF/UHF screen, src/rtl_spectrum.c): rows of averaged
	  FFTs on its standard output, retuned from its standard input.
	  Installed as /usr/bin/x6x00-rtlspec; its source is this
	  repository's tools/rtlspec.
```
